// File generated 10/13/2015 4:34:44 PM
// Warning! This is a generated file, any manual changes will be
// lost during the next generation.

// object indexes for Inputs, Image Addresses + Input Array
#CONST
    iUserimages1
    iUserimages2
    iUserimages3
    iUserimages4
    iUserimages1H     0x0000
    iUserimages1L     0x0000
    iUserimages2H     0x0004
    iUserimages2L     0x0200
    iUserimages3H     0x017B
    iUserimages3L     0x8400
    iVideo1H          0x017E
    iVideo1L          0x0600
    iUserimages4H     0x01B9
    iUserimages4L     0x8800
    iVideo2H          0x01BA
    iVideo2L          0x0A00
    iVideo3H          0x01EB
    iVideo3L          0x0C00
    iVideo4H          0x01FE
    iVideo4L          0x8E00
    Inputs          4
#END

#DATA
    word InputX1 0, 0, 0, 0
    word InputX2 127, 127, 127, 127
    word InputY1 0, 0, 0, 0
    word InputY2 127, 127, 127, 127
    word InputH 0x0000, 0x0004, 0x017B, 0x01B9
    word InputL 0x0000, 0x0200, 0x8400, 0x8800
#END

var curInput ;
